## boards/shields/baseform/Kconfig.defconfig
```kconfig
# -------------------------
# Central (Duo or Trio base)
# -------------------------
if SHIELD_BASEFORM_TRIO_BASE_CENTRAL || SHIELD_BASEFORM_DUO_LEFT_CENTRAL

config ZMK_KEYBOARD_NAME
    default "baseform"

# Point ZMK to the keymap file based on the layout above
config ZMK_KEYMAP
    string
    default "config/$(KEYMAP_LAYOUT)/baseform.keymap"

config ZMK_SPLIT_ROLE_CENTRAL
    bool
    default y

# # Allow selecting layout via -DCONFIG_KEYMAP_LAYOUT="qwerty" (default qwerty)
# config KEYMAP_LAYOUT
#     string "Keymap layout"
#     default "qwerty"
# 
# # Raise Zephyr device name limit only for centrals (prevents overflow on long DT paths)
# config DEVICE_MAX_NAME_LEN
#     int
#     default 128

endif # central

# -------------------------
# Split (all participating halves)
# -------------------------
if SHIELD_BASEFORM_TRIO_BASE_CENTRAL || SHIELD_BASEFORM_TRIO_LEFT_PERIPHERAL || \
   SHIELD_BASEFORM_DUO_LEFT_CENTRAL  || SHIELD_BASEFORM_ANY_RIGHT_PERIPHERAL

config ZMK_SPLIT
    default y

config ZMK_RGB_UNDERGLOW
    default y

endif # split

# -------------------------
# Display config (if enabled)
# -------------------------
if ZMK_DISPLAY

config I2C
    default y

config SSD1306
    default y

endif # ZMK_DISPLAY

# -------------------------
# LVGL display params (if enabled)
# -------------------------
if LVGL

config LV_Z_VDB_SIZE
    default 64

config LV_DPI_DEF
    default 148

config LV_Z_BITS_PER_PIXEL
    default 1

choice LV_COLOR_DEPTH
    default LV_COLOR_DEPTH_1
endchoice

endif # LVGL
```
