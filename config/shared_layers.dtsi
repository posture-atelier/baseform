    symbols {	
      display-name = "symbols";
      bindings = <
        TRANS_ROW
        TRANS_FLANK( &none      &kp LPAR   &kp LT     &kp LBKT   &kp LBRC     &kp RBRC   &kp RBKT  &kp GT    &kp RPAR  &none     )
        TRANS_FLANK( &kp TILDE  &kp SEMI   &kp EXCL   &kp QMARK  &kp UNDER    &kp EQUAL  &kp AT    &kp HASH  &kp COLN  &kp CARET )
        TRANS_FLANK( &none      &kp GRAVE  &kp AMPS   &kp FSLH   &none        &none      &kp BSLH  &kp DLLR  &kp PIPE  &none     )
                                           &trans     &none      &trans       &trans     &trans    &trans
      >;
    };

    navigation {
      display-name = "navigate";
      bindings = <
        TRANS_ROW
        TRANS_FLANK( &kp PRCNT  &kp N7  &kp N8    &kp N9  &kp PLUS        &none      &kp HOME   &kp UP    &kp PG_UP    &none     )
        TRANS_FLANK( &kp DOT    &kp N4  &kp N5    &kp N6  &kp MINUS       &none      &kp LEFT   &kp DOWN  &kp RIGHT    &none     )
        TRANS_FLANK( &kp COMMA  &kp N1  &kp N2    &kp N3  &kp ASTRK       &none      &kp END    &kp DOWN  &kp PG_DN    &none     )
                                        &kp EQUAL &kp N0  &kp FSLH        &trans     &none      &trans 
      >;
    };

    function {
      display-name = "function";
      bindings = <
        TRANS_ROW
        TRANS_FLANK( &kp C_BRI_UP  &kp F7  &kp F8  &kp F9  &kp F10      &none         &none         &none      &none       &none      )
        TRANS_FLANK( &kp C_BRI_DN  &kp F4  &kp F5  &kp F6  &kp F11      &kp KP_NUM    &kp CAPS      &kp SLCK   &kp PSCRN   &kp INS    )
        TRANS_FLANK( &none         &kp F1  &kp F2  &kp F3  &kp F12      &kp C_VOL_UP  &kp C_VOL_DN  &kp C_PP   &kp C_NEXT  &kp C_PREV )
                                           &kp ESC &trans  &trans       &none         &trans        &trans
      >;
    };

    meta {
      display-name = "zmk";
      bindings = <
        TRANS_ROW
        TRANS_FLANK( &soft_off       &out OUT_USB  &out OUT_BLE  &none         &bt BT_CLR     &ext_power EP_TOG &trans     &trans      &none &soft_off )
        TRANS_FLANK( &bt BT_SEL 0    &bt BT_SEL 1  &bt BT_SEL 2  &bt BT_SEL 3  &bt BT_SEL 4   &none             &none      &none       &none &none     )
        TRANS_FLANK( &studio_unlock  &none         &bootloader   &sys_reset    &none          &none             &sys_reset &bootloader &none &none     )
                                                   &none         &trans        &tog 0         &trans            &trans     &none
      >;
    };

